## firmware/brain-core/sdkconfig.defaults
```kconfig
# Target
CONFIG_IDF_TARGET="esp32s3"

# Flash — N16R8: 16MB QIO 80MHz
CONFIG_ESPTOOLPY_FLASHSIZE_16MB=y
CONFIG_ESPTOOLPY_FLASHMODE_QIO=y
CONFIG_ESPTOOLPY_FLASHFREQ_80M=y

# PSRAM — N16R8: 8MB OPI (octal)
CONFIG_ESP32S3_SPIRAM_SUPPORT=y
CONFIG_SPIRAM_MODE_OCT=y
CONFIG_SPIRAM_SPEED_80M=y
CONFIG_SPIRAM_BOOT_INIT=y

# Partition table
CONFIG_PARTITION_TABLE_CUSTOM=y
CONFIG_PARTITION_TABLE_CUSTOM_FILENAME="partitions.csv"

# Disable Bluetooth — saves ~100KB RAM
CONFIG_BT_ENABLED=n

# Log level
CONFIG_LOG_DEFAULT_LEVEL_INFO=y
CONFIG_LOG_MAXIMUM_LEVEL_DEBUG=y

# Task Watchdog (5s)
CONFIG_ESP_TASK_WDT_EN=y
CONFIG_ESP_TASK_WDT_TIMEOUT_S=5
CONFIG_ESP_TASK_WDT_CHECK_IDLE_TASK_CPU0=n
CONFIG_ESP_TASK_WDT_CHECK_IDLE_TASK_CPU1=n

# MQTT buffer
CONFIG_MQTT_BUFFER_SIZE=1024
CONFIG_MQTT_OUTBOX_EXPIRED_TIMEOUT_MS=30000

# TLS cert bundle — lets the /voice WSS client verify Heroku's cert
CONFIG_MBEDTLS_CERTIFICATE_BUNDLE=y
CONFIG_MBEDTLS_CERTIFICATE_BUNDLE_DEFAULT_FULL=y

# OTA — HTTPS only
CONFIG_OTA_ALLOW_HTTP=n

# ADC
CONFIG_ADC_ONESHOT_CTRL_FUNC_IN_IRAM=y

# Stack sizes
CONFIG_ESP_MAIN_TASK_STACK_SIZE=4096
```
